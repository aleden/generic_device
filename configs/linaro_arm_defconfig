## configs/linaro_arm_defconfig
```kconfig
CONFIG_ARCH_ARM=y
CONFIG_BOARD_HAVE_BLUETOOTH_LINUX=y
CONFIG_QCOM_WIFI=n
CONFIG_TI_WILINK_WIFI=n
CONFIG_SENSOR=y
```

## wifi/Kconfig
```kconfig
menuconfig WIFI
	bool "WiFi support"

if WIFI

config QCOM_FLO_WIFI
	bool "Qualcomm WCNSS wifi support for Nexus7 devices"

config TI_WILINK_WIFI
	bool "TI WILINK wifi support"

endif
```
